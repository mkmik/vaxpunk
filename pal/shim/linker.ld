/* The Limine protocol requires executables at or above 0xffffffff80000000. */
ENTRY(_start)

PHDRS
{
	text   PT_LOAD FLAGS(5); /* R-X */
	rodata PT_LOAD FLAGS(4); /* R-- */
	data   PT_LOAD FLAGS(6); /* RW- */
}

SECTIONS
{
	. = 0xffffffff80000000;

	.text : {
		*(.text.entry)
		*(.text .text.*)
	} :text

	. = ALIGN(4096);
	.rodata : { *(.rodata .rodata.*) } :rodata

	. = ALIGN(4096);
	.data : {
		*(.data .data.*)
		KEEP(*(.limine_requests))
	} :data
	.bss : { *(.bss .bss.*) *(COMMON) } :data

	/DISCARD/ : { *(.eh_frame*) *(.note .note.*) *(.comment) }
}
